#include <TWELITE>
#include <NWK_SIMPLE>

#include "display.hpp"

#define CHARS_COLS_LENGTH  8

static const uint8_t FONTS[][CHARS_COLS_LENGTH]  = {
    {0x00,0x00,0x00,0x00,0x00,0x00,0x00,0x00},	// 0x20
    {0x00,0x06,0x5F,0x5F,0x06,0x00,0x00,0x00},	// 0x21
    {0x00,0x07,0x07,0x00,0x07,0x07,0x00,0x00},	// 0x22
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    {0x78,0x7C,0x46,0x43,0x46,0x7C,0x78,0x00},	// 0x7F
};

uint8_t m_initCommand[33] = {
    0x00, 0xA8, 0x3F, // SetMultiplexRatio
    0x00, 0xD3, 0x00, // SetDisplayOffset
    0x80, 0x40,       // SetDisplayStartline
    0x80, 0xA1,       // SetSegmentRemap
    0x80, 0xC8,       // SetCOMOutputScanDirection
    0x00, 0xDA, 0x12, // SetCOMPingsHardwareConfiguration
    0x00, 0x81, 0x7F, // SetCntrastControl
    0x80, 0xA4,       // EntireDisplayON
    0x80, 0xA6,       // SetNormalDisplay
    0x00, 0xD5, 0x80, // SetOscFrequency
    0x00, 0x8D, 0x14, // EnableChargePumpRegulator
    0x80, 0xAF        // Display ON
};

enum class BTN
{
    R = 24,
    U = 25,
    L = 22,
    C = 23,
    D = 19
};

const uint8_t BTN_PIN[5] = {24, 25, 22, 23, 19};
Display Display;

void setup()
{
    Serial.begin(115200);
    Wire.begin();

    for (int i = 13; i <= 16; i++)
        pinMode(i, PIN_MODE::INPUT);
    for (auto p : BTN_PIN)
        pinMode(p, PIN_MODE::INPUT);

    // Display.init(0x3C);

    Wire.beginTransmission(0x3C);
    for (auto &cmd : m_initCommand)
        Wire.write(cmd);
    Wire.endTransmission();

    
    Wire.beginTransmission(0x3C);
    /*
    for (int p = 0; p < 20; p++){
        Wire.beginTransmission(0x3C);
        Wire.write(0x80);
        Wire.write(0xB0 | (p & 0x07));
        Wire.endTransmission();
        
        Wire.beginTransmission(0x3C);
        Wire.write(0x40);
        for (int i = 0; i < 20; i++)
        {
            Wire.write(0x00);
        }
        Wire.endTransmission();
        Wire.beginTransmission(0x3C);
    }*/


    Serial.println("setup() finish!");
}

void loop()
{
    static int count = 0;
    // bool btn[5]{};
    // for(int i=0;i<5;i++) btn[i] = digitalRead(BTN_PIN[i]);
    // for(auto b:btn) Serial.print(b);
    // Serial.println();

    int32_t v = digitalReadBitmap();
    for (int i = 0; i < 1; i++)
        Serial.print(v >> i & 0b01);
    Serial.println();


    Wire.beginTransmission(0x3C);
     int p = 3;
    // for (int p = 0; p < 50; p++){//このfor文ON & Wire.write(0x00) & pの値でかくしたら画面クリア
        Wire.beginTransmission(0x3C);
        Wire.write(0x80);
        Wire.write(0xB0 | (p & 0x07));
        Wire.endTransmission();
        
        Wire.beginTransmission(0x3C);
        Wire.write(0x40);
        for (int i = 0; i < 7; i++)
        {
            // Wire.write(FONTS[(p*16+i/8)%(sizeof(FONTS)/sizeof(FONTS[0]))][i%8]);
             Wire.write(FONTS[33][i]);
            // Wire.write(0x00);
        }
        // for (int i = 0; i < 0; i++)
        // {
        //     // Wire.write(FONTS[(p*16+i/8)%(sizeof(FONTS)/sizeof(FONTS[0]))][i%8]);
        //     Wire.write(FONTS[2][i]);
        //     // Wire.write(0x00);
        // }
        Wire.endTransmission();
        Wire.beginTransmission(0x3C);
    // }

    Wire.endTransmission();
    Serial.println(count);

    count++;
    delay(100);
}