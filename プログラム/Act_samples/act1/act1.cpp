#include <TWELITE>
#include <NWK_SIMPLE>
#include "display.hpp"


//displayyyyyyyyyyyyyyyyyyyyyyyyyyyyyyyyyyyyyyyyyyyyyyyyyyyyyyyyyyyyyyyyyyyyyyyyyyyyyyyyyyyyyyyyyyyyyyyyyyy

#define CHARS_COLS_LENGTH 8
static const uint8_t FONTS[][CHARS_COLS_LENGTH]  = {
    {0x00,0x00,0x00,0x00,0x00,0x00,0x00,0x00},	// 0x20
    {0x00,0x06,0x5F,0x5F,0x06,0x00,0x00,0x00},	// 0x21
    {0x00,0x07,0x07,0x00,0x07,0x07,0x00,0x00},	// 0x22
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    {0x78,0x7C,0x46,0x43,0x46,0x7C,0x78,0x00},	// 0x7F
};

// application ID
const uint32_t APP_ID = 0x1234abcd;

// channel
const uint8_t CHANNEL = 13;

// DIO pins
const uint8_t PIN_BTN = 12;

/*** function prototype */
void vTransmit(const char* msg, int num ,uint32_t addr);

/*** application defs */
// packet message


//button letterrrrrrrrrrrrrrrrrrrrrrrrrrrrrrrrrrrrrrrrrrrrrrrrrrrrrrrrrrrrrrrrrrrrrrrrrrrrrrrrrrrrrrrrr
int up = 0;
int down = 0;
int right = 0;
int left = 0;
int center = 0;
char english[27] = {'!', 'a', 'b', 'c', 'd', 'e', 'f', 'g', 'h', 'i', 'j', 'k', 'l', 'm', 'n', 'o', 'p', 'q', 'r', 's', 't', 'u', 'v', 'w', 'x', 'y', 'z'};
char output[] = {' '};
char confirmed[] = {' '};
int confirmednum[] = {};
int count = 0;//timer
int index = 0;//0~25
int letnum = 0;
//button letterrrrrrrrrrrrrrrrrrrrrrrrrrrrrrrrrrrrrrrrrrrrrrrrrrrrrrrrrrrrrrrrrrrrrrrrrrrrrrrrrrrrrrrrr

uint8_t m_initCommand[33] = {
    0x00, 0xA8, 0x3F, // SetMultiplexRatio
    0x00, 0xD3, 0x00, // SetDisplayOffset
    0x80, 0x40,       // SetDisplayStartline
    0x80, 0xA1,       // SetSegmentRemap
    0x80, 0xC8,       // SetCOMOutputScanDirection
    0x00, 0xDA, 0x12, // SetCOMPingsHardwareConfiguration
    0x00, 0x81, 0x7F, // SetCntrastControl
    0x80, 0xA4,       // EntireDisplayON
    0x80, 0xA6,       // SetNormalDisplay
    0x00, 0xD5, 0x80, // SetOscFrequency
    0x00, 0x8D, 0x14, // EnableChargePumpRegulator
    0x80, 0xAF        // Display ON
};

enum class BTN
{
    R = 24,
    U = 25,
    L = 22,
    C = 23,
    D = 19
};

const uint8_t BTN_PIN[5] = {24, 25, 22, 23, 19};
Display Display;
//displayyyyyyyyyyyyyyyyyyyyyyyyyyyyyyyyyyyyyyyyyyyyyyyyyyyyyyyyyyyyyyyyyyyyyyyyyyyyyyyyyyyyyyyyyyyyyyyyyyy


/*** setup procedure (run once at cold boot) */
void setup() {
    Serial.begin(115200);
    Wire.begin();
//button letterrrrrrrrrrrrrrrrrrrrrrrrrrrrrrrrrrrrrrrrrrrrrrrrrrrrrrrrrrrrrrrrrrrrrrrrrrrrrrrrrrrrrrrrr
    Analogue.begin(pack_bits(PIN_ANALOGUE::A1,PIN_ANALOGUE::A2,PIN_ANALOGUE::VCC), 100);//center, left
    pinMode(0, INPUT);//right
    pinMode(1, INPUT);//up
    pinMode(17, INPUT);//down
    Analogue.setup();
//button letterrrrrrrrrrrrrrrrrrrrrrrrrrrrrrrrrrrrrrrrrrrrrrrrrrrrrrrrrrrrrrrrrrrrrrrrrrrrrrrrrrrrrrrrr
	
	
	// the twelite main class
	the_twelite
		<< TWENET::appid(APP_ID)    // set application ID (identify network group)
		<< TWENET::channel(CHANNEL) // set channel (pysical channel)
		<< TWENET::rx_when_idle();  // open receive circuit (if not set, it can't listen packts from others)

	// Register Network
	auto&& nwksmpl = the_twelite.network.use<NWK_SIMPLE>();
	nwksmpl << NWK_SIMPLE::logical_id(0xFE) // set Logical ID. (0xFE means a child device with no ID)
	        << NWK_SIMPLE::repeat_max(3);   // can repeat a packet up to three times. (being kind of a router)

	the_twelite.begin(); // start twelite!

	/*** INIT message */
	Serial << "--- PingPong sample (press 't' to transmit) ---" << mwx::crlf;

    for (int i = 13; i <= 16; i++)
        pinMode(i, PIN_MODE::INPUT);
    for (auto p : BTN_PIN)
        pinMode(p, PIN_MODE::INPUT);


    Wire.beginTransmission(0x3C);
    for (auto &cmd : m_initCommand)
        Wire.write(cmd);
    Wire.endTransmission();

    
    Wire.beginTransmission(0x3C);
    Serial.println("setup() finish!");
}

/*** loop procedure (called every event) */
void loop() {
//button letterrrrrrrrrrrrrrrrrrrrrrrrrrrrrrrrrrrrrrrrrrrrrrrrrrrrrrrrrrrrrrrrrrrrrrrrrrrrrrrrrrrrrrrrr
    if(int(Analogue.read(PIN_ANALOGUE::A1)) > 2000){
        // Serial.println("center");
        if(english[index] == '!'){
            confirmed[letnum - 1] = ' ';
            confirmednum[letnum - 1] = ' ';
            letnum = letnum - 1;
            delay(200);
        }else{
            confirmed[letnum] = english[index];
            confirmednum[letnum] = int(index);
            letnum = letnum + 1;
        }
        Serial.printfmt("Send : %s", confirmed);
        Serial.println();
        delay(200);
    }
    if(int(Analogue.read(PIN_ANALOGUE::A2)) > 2000 && index > 0){
        // Serial.println("left");
        index = index - 1;
        Serial.printfmt("%c", english[index]);
        Serial.println();
        delay(200);
    }
    if(digitalRead(0) == HIGH && index < 25){
        // Serial.println("right");
        index = index + 1;  
        Serial.printfmt("%c", english[index]);
        Serial.println();
        delay(200);
    }
    if(digitalRead(1) == HIGH){
        // Serial.println("up");
		Serial.println("trying to send message");
    	vTransmit(confirmed,0,0x00);
		Serial.println("message has been sent");
        delay(200);
    }
    if(digitalRead(17) == HIGH){
        // Serial.println("down");
    }
//button letterrrrrrrrrrrrrrrrrrrrrrrrrrrrrrrrrrrrrrrrrrrrrrrrrrrrrrrrrrrrrrrrrrrrrrrrrrrrrrrrrrrrrrrrr

    static int count = 0;
    int32_t v = digitalReadBitmap();
    for (int i = 0; i < 1; i++)
        Serial.print(v >> i & 0b01);
    Serial.println();
    Wire.beginTransmission(0x3C);
     int p = 3;
        Wire.beginTransmission(0x3C);
        Wire.write(0x80);
        Wire.write(0xB0 | (p & 0x07));
        Wire.endTransmission();
        
        Wire.beginTransmission(0x3C);
        Wire.write(0x40);
        for (int i = 0; i < 7; i++)
        {
            if(index == 0){
              Wire.write(FONTS[index + 1][i]);
            }else{
             Wire.write(FONTS[index + 32][i]);

            }
        }
        Wire.endTransmission();
        Wire.beginTransmission(0x3C);

    Wire.endTransmission();
    Serial.println(count);

    count++;
    delay(100);
}

/**
 * @fn	void vTransmit(const char *msg, uint32_t addr)
 *
 * @brief	Transmits the given message.
 *
 *          The packet data structure is:
 *            uint8_t[4] : the message "PING" or "PONG"
 *            uint16_t   : A1=ADC0 adc value [0..1023 (max=2470mV)]
 *            uint16_t   : Vcc [mV]
 *            uint32_t   : system timer count in ms.
 *
 * @param msg	the message with length of MSG_LEN.
 * @param addr	destination address
 *
 */
void vTransmit(const char* msg,int num, uint32_t addr) {
	Serial << "vTransmit()" << mwx::crlf;
	if (auto&& pkt = the_twelite.network.use<NWK_SIMPLE>().prepare_tx_packet()) {
		// set tx packet behavior
		pkt << tx_addr(addr)  // 0..0xFF (LID 0:parent, FE:child w/ no id, FF:LID broad cast), 0x8XXXXXXX (long address)
			<< tx_retry(0x3) // set retry (0x3 send four times in total)
			<< tx_packet_delay(100,200,20); // send packet w/ delay (send first packet with randomized delay from 100 to 200ms, repeat every 20ms)

		// prepare packet payload
		pack_bytes(pkt.get_payload() // set payload data objects.
			, make_pair(msg,80) // string should be paired with length explicitly.
			, uint16_t(num)
			, uint32_t(millis()) // put timestamp here.
		);
	
		// do transmit 
		pkt.transmit();
	}
}
